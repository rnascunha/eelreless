## examples/flow_controller/main/Kconfig.projbuild
```kconfig
menu "Control Flow Parameters"
  config ESP_WIFI_SSID
    string "WiFi SSID"
    default "myssid"
    help
        SSID (network name) for the example to connect to.

  config ESP_WIFI_PASSWORD
    string "WiFi Password"
    default "mypassword"
    help
        WiFi password (WPA or WPA2) for the example to use.

  choice ESP_WIFI_SAE_MODE
    prompt "WPA3 SAE mode selection"
    default ESP_WPA3_SAE_PWE_BOTH
    help
        Select mode for SAE as Hunt and Peck, H2E or both.
    config ESP_WPA3_SAE_PWE_HUNT_AND_PECK
        bool "HUNT AND PECK"
    config ESP_WPA3_SAE_PWE_HASH_TO_ELEMENT
        bool "H2E"
    config ESP_WPA3_SAE_PWE_BOTH
        bool "BOTH"
  endchoice

  config ESP_WIFI_PW_ID
    string "PASSWORD IDENTIFIER"
    depends on  ESP_WPA3_SAE_PWE_HASH_TO_ELEMENT|| ESP_WPA3_SAE_PWE_BOTH
    default ""
    help
        password identifier for SAE H2E

  config ESP_MAXIMUM_RETRY
    int "Maximum retry"
    default 5
    help
        Set the Maximum retry to avoid station reconnecting to the AP unlimited when the AP is really inexistent.

  choice ESP_WIFI_SCAN_AUTH_MODE_THRESHOLD
    prompt "WiFi Scan auth mode threshold"
    default ESP_WIFI_AUTH_WPA2_PSK
    help
      The weakest authmode to accept in the scan mode.
      This value defaults to ESP_WIFI_AUTH_WPA2_PSK incase password is present and ESP_WIFI_AUTH_OPEN is used.
      Please select ESP_WIFI_AUTH_WEP/ESP_WIFI_AUTH_WPA_PSK incase AP is operating in WEP/WPA mode.

    config ESP_WIFI_AUTH_OPEN
        bool "OPEN"
    config ESP_WIFI_AUTH_WEP
        bool "WEP"
    config ESP_WIFI_AUTH_WPA_PSK
        bool "WPA PSK"
    config ESP_WIFI_AUTH_WPA2_PSK
        bool "WPA2 PSK"
    config ESP_WIFI_AUTH_WPA_WPA2_PSK
        bool "WPA/WPA2 PSK"
    config ESP_WIFI_AUTH_WPA3_PSK
        bool "WPA3 PSK"
    config ESP_WIFI_AUTH_WPA2_WPA3_PSK
        bool "WPA2/WPA3 PSK"
    config ESP_WIFI_AUTH_WAPI_PSK
        bool "WAPI PSK"
  endchoice

  config ENABLE_MDNS
    bool "Enable local name resolution"
    default y
    help
      Make your device reachable at the local network using a easy 
      name (instead of a IP).

  config MDNS_HOSTNAME
    string "Local hostname"
    default "flow_control"
    depends on ENABLE_MDNS
    help
      Name that the device will be reachable locally (<name>.local)

  config VALVE_GPIO
    int "GPIO connected to valve"
    default 21
    help
      GPIO port connected to the on/off valve

  config SENSOR_GPIO
    int "GPIO connect to sensor data"
    default 17
    help
      GPIO port connected to the sensor data line

  config FLOW_CONTROL_PULSE_COUNT
    int "Pulses to count 'steps' volume unit"
    default 450
    help
      The number of pulses necessary to make 1L

  config ENABLE_SAFE_TIMER_IDLE
    bool "Enable timer idle timer"
    default y
    help
      This will enable a timer that will close the valve if no fluid 
      is detected at the sensor at X seconds

  config SAFE_TIMER_IDLE_MILISECONDS
    int "Mili seconds to wait to close valve"
    default 5000
    depends on ENABLE_SAFE_TIMER_IDLE
    help
      Time to wait to check if any fluid pass the valve and close it
      if necessary

endmenu
```
